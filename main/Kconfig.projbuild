## main/Kconfig.projbuild
```kconfig
menu "Select Ulip Model"
    choice MODEL
        prompt "Ulip Model"
        default _MLI_1WQB_TYPE__
        help
            Select ulip model to compile.

        config _MLI_1WQB_TYPE__
            bool "WQB"
            help
                Model with RF433 RS485.
        config _MLI_1WRS_TYPE__
            bool "WRS"
            help
                Model with RF433 Sensors.
    endchoice
endmenu
```
